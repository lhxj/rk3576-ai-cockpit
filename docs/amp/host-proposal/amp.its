## docs/amp/host-proposal/amp.its
```
/dts-v1/;
/ {
    description = "HOST PROPOSAL - cold BUS M0";
    #address-cells = <1>;
    images { mcu {
        description = "bus_mcu"; data = /incbin/("rttmcu.bin");
        type = "standalone"; arch = "arm"; compression = "none";
        load = <0x47800000>; entry = <0x141>;
        rockchip,mcu-shared-window-base = <0x40000000>;
        hash { algo = "sha256"; };
    }; };
    configurations { default = "conf";
        conf { loadables = "mcu"; };
    };
};
```

## platform/rk3576/amp-minimal/amp-signed.its
```
/dts-v1/;
/ {
    description = "P029 development signed cold BUS M0";
    totalsize = <0x1fc00>;
    #address-cells = <1>;
    images { mcu {
        description = "bus_mcu"; data = /incbin/("rttmcu.bin");
        type = "standalone"; arch = "arm"; compression = "none";
        load = <0x47800000>; entry = <0x141>;
        rockchip,mcu-code-size = <0x80000>;
        rockchip,mcu-shared-region = <0x47d00000 0x20000>;
        rockchip,mcu-shared-window-base = <0x40000000>;
        hash { algo = "sha256"; };
    }; };
    configurations { default = "conf"; conf {
        loadables = "mcu";
        signature { algo = "sha256,rsa2048"; key-name-hint = "p029dev";
            sign-images = "loadables"; };
    }; };
};
```
