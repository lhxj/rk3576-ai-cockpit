// SPDX-License-Identifier: GPL-2.0
// Host-reviewed candidate only. Requires derived firmware and explicit deployment approval.
/dts-v1/;
/plugin/;
/ {
    fragment@0 {
        target-path = "/mcu-amp";
        __overlay__ {
            // Preserve all five frozen BUS M0/UART clocks; add only I2C9 pclk/function.
            clocks = <&cru 207>, <&cru 208>, <&cru 209>, <&cru 139>, <&cru 150>,
                     <&cru 118>, <&cru 130>;
            assigned-clocks = <&cru 150>, <&cru 130>;
            // Zero keeps the existing UART parent. I2C9 selects fixed xin24m (mux=3).
            assigned-clock-parents = <0>, <&xin24m>;
            assigned-clock-rates = <24000000>, <24000000>;
            pinctrl-names = "default";
            pinctrl-0 = <&uart5m0_xfer>, <&i2c9m1_xfer>;
        };
    };
    fragment@1 {
        target = <&i2c9>;
        __overlay__ { status = "disabled"; };
    };
};
